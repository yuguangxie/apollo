VERSION ""

BO_ 256 VEH_STATUS: 8 ECU
 SG_ SPEED : 0|16@1+ (0.1,0) [0|250] "km/h" ECU
 SG_ STEER_ANGLE : 16|16@1- (0.1,0) [-500|500] "deg" ECU

BO_ 512 CTRL_CMD: 8 ECU
 SG_ THROTTLE_CMD : 7|12@0+ (0.1,0) [0|100] "%" ECU
 SG_ BRAKE_CMD : 23|12@0+ (0.1,0) [0|100] "%" ECU
